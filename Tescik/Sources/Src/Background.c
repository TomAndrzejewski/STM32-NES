/*
 * Background.c
 *
 *  Created on: 5 cze 2026
 *      Author: tomasz
 */

#include "LCDControl.h"
#include "RenderEngine.h"
#include "Background.h"

const uint16_t bg_floor_16x16_dma[256] = {
		0xc3e8, 0x0000, 0x0000, 0x0000, 0x0000, 0x0000, 0x0000, 0xc3e8, 0xbdf7, 0x0000, 0x0000, 0x0000, 0x0000, 0x0000, 0x0000, 0xc3e8,
		0xbdf7, 0x00d0, 0x00d0, 0x00d0, 0x00d0, 0x00d0, 0x00d0, 0x0000, 0xbdf7, 0x00d0, 0x00d0, 0x00d0, 0x00d0, 0x00d0, 0x0000, 0x0000,
		0xbdf7, 0x00d0, 0x00d0, 0x00d0, 0xbdf7, 0xbdf7, 0xbdf7, 0x0000, 0xbdf7, 0x00d0, 0x00d0, 0x00d0, 0x00d0, 0x00d0, 0x00d0, 0x0000,
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		0xc3e8, 0xbdf7, 0xbdf7, 0xbdf7, 0xbdf7, 0xbdf7, 0xbdf7, 0xbdf7, 0xbdf7, 0x0000, 0xc3e8, 0xbdf7, 0xbdf7, 0xbdf7, 0xbdf7, 0xc3e8
};

const uint16_t bg_jedynka_32x32_dma[32*32] = {
		0xffff, 0xffff, 0xffff, 0xffff, 0xffff, 0xffff, 0xffff, 0xffff, 0xffff, 0xffff, 0xffff, 0xffff, 0xffff, 0xffff, 0xffff, 0xffff, 0xffff, 0xffff, 0xffff, 0xffff, 0xffff, 0xffff, 0xffff, 0xffff, 0xffff, 0xffff, 0xffff, 0xffff, 0xffff, 0xffff, 0xffff, 0xffff,
		0xffff, 0xffff, 0xffff, 0xffff, 0xffff, 0xffff, 0xffff, 0xffff, 0xffff, 0xffff, 0xffff, 0xffff, 0xffff, 0xffff, 0xffff, 0xffff, 0xffff, 0xffff, 0xffff, 0xffff, 0xffff, 0xffff, 0xffff, 0xffff, 0xffff, 0xffff, 0xffff, 0xffff, 0xffff, 0xffff, 0xffff, 0xffff,
		0xffff, 0xffff, 0xffff, 0xffff, 0xffff, 0xffff, 0xffff, 0xc318, 0xc318, 0xc318, 0xc318, 0xc318, 0xc318, 0xc318, 0xc318, 0xc318, 0xc318, 0xc318, 0xc318, 0xc318, 0xc318, 0xc318, 0xc318, 0xc318, 0xffff, 0xffff, 0xffff, 0xffff, 0xffff, 0xffff, 0xffff, 0xffff,
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		0xffff, 0xffff, 0xffff, 0xffff, 0xffff, 0xffff, 0xffff, 0xffff, 0xffff, 0xffff, 0xffff, 0xffff, 0xffff, 0xffff, 0xc318, 0xc318, 0xc318, 0xffff, 0xffff, 0xffff, 0xffff, 0xffff, 0xffff, 0xffff, 0xffff, 0xffff, 0xffff, 0xffff, 0xffff, 0xffff, 0xffff, 0xffff
};

const uint16_t bg_dwojka_32x32_dma[32*32] = {
		0xffff, 0xffff, 0xffff, 0xffff, 0xffff, 0xffff, 0xffff, 0xffff, 0xffff, 0xffff, 0xffff, 0xffff, 0xffff, 0xffff, 0xffff, 0xffff, 0xffff, 0xffff, 0xffff, 0xffff, 0xffff, 0xffff, 0xffff, 0xffff, 0xffff, 0xffff, 0xffff, 0xffff, 0xffff, 0xffff, 0xffff, 0xffff,
		0xffff, 0xffff, 0xffff, 0xffff, 0xffff, 0xffff, 0xffff, 0xffff, 0xffff, 0xffff, 0xffff, 0xffff, 0xffff, 0xffff, 0xffff, 0xffff, 0xffff, 0xffff, 0xffff, 0xffff, 0xffff, 0xffff, 0xffff, 0xffff, 0xffff, 0xffff, 0xffff, 0xffff, 0xffff, 0xffff, 0xffff, 0xffff,
		0xffff, 0xffff, 0xffff, 0xffff, 0xffff, 0xffff, 0xffff, 0xffff, 0xffff, 0xffff, 0xffff, 0xffff, 0xffff, 0xffff, 0xffff, 0xffff, 0xffff, 0xffff, 0xffff, 0xffff, 0xffff, 0xffff, 0xffff, 0xffff, 0xffff, 0xffff, 0xffff, 0xffff, 0xffff, 0xffff, 0xffff, 0xffff,
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		0xffff, 0xffff, 0xffff, 0xffff, 0xffff, 0xffff, 0xffff, 0xffff, 0xffff, 0xffff, 0x4108, 0x4108, 0x4108, 0x4108, 0x4108, 0x4108, 0x4108, 0x4108, 0xffff, 0xffff, 0xffff, 0xffff, 0xffff, 0xffff, 0xffff, 0xffff, 0xffff, 0xffff, 0xffff, 0xffff, 0xffff, 0xffff
};


int BG_Init(Background_t* p)
{
	if (p == NULL)	{ return -1; }

	p->floorSprite.sprite.bitmap = bg_floor_16x16_dma;
	p->floorSprite.sprite.size.x = 16;
	p->floorSprite.sprite.size.y = 16;
	p->floorSprite.mulVector.x = LCD_WIDTH/16;
	p->floorSprite.mulVector.y = 2;

	p->floorPixelPos.x = 0;
	p->floorPixelPos.y = 0;


	p->jedynkaSprite.bitmap = bg_jedynka_32x32_dma;
	p->jedynkaSprite.size.x = 32;
	p->jedynkaSprite.size.y = 32;

	p->jedynkaPixelPos.x = 80;
	p->jedynkaPixelPos.y = 120;


	p->dwojkaSprite.bitmap = bg_dwojka_32x32_dma;
	p->dwojkaSprite.size.x = 32;
	p->dwojkaSprite.size.y = 32;

	p->dwojkaPixelPos.x = 240;
	p->dwojkaPixelPos.y = 120;

	return 0;
}

int BG_RenderJedynka(Background_t* p)
{
	if (p == NULL)	{ return -1; }

	Rect_t spriteRect;
	spriteRect.p1.x = 0;
	spriteRect.p1.y = 0;
	spriteRect.p2.x = p->jedynkaSprite.size.x;
	spriteRect.p2.y = p->jedynkaSprite.size.y;

	Rect_t baseRect;
	baseRect.p1.x = p->jedynkaPixelPos.x;
	baseRect.p1.y = p->jedynkaPixelPos.y;
	baseRect.p2.x = p->jedynkaPixelPos.x + p->jedynkaSprite.size.x;
	baseRect.p2.y = p->jedynkaPixelPos.y + p->jedynkaSprite.size.y;

	Point_t baseToSpriteOffset;
	memset(&baseToSpriteOffset, 0, sizeof(baseToSpriteOffset));

	LCD_DrawRect(baseRect);

	RE_RenderSprite(p->jedynkaSprite.bitmap, baseRect, spriteRect, baseToSpriteOffset, true);

	return 0;
}

int BG_RenderDwojka(Background_t* p)
{
	if (p == NULL)	{ return -1; }

	Rect_t spriteRect;
	spriteRect.p1.x = 0;
	spriteRect.p1.y = 0;
	spriteRect.p2.x = p->dwojkaSprite.size.x;
	spriteRect.p2.y = p->dwojkaSprite.size.y;

	Rect_t baseRect;
	baseRect.p1.x = p->dwojkaPixelPos.x;
	baseRect.p1.y = p->dwojkaPixelPos.y;
	baseRect.p2.x = p->dwojkaPixelPos.x + p->dwojkaSprite.size.x;
	baseRect.p2.y = p->dwojkaPixelPos.y + p->dwojkaSprite.size.y;

	Point_t baseToSpriteOffset;
	memset(&baseToSpriteOffset, 0, sizeof(baseToSpriteOffset));

	LCD_DrawRect(baseRect);

	RE_RenderSprite(p->dwojkaSprite.bitmap, baseRect, spriteRect, baseToSpriteOffset, true);

	return 0;
}

int BG_RenderFloor(Background_t* p)
{
	if (p == NULL)	{ return -1; }

	Rect_t spriteRect;
	Rect_t baseRect;
	Point_t baseToSpriteOffset;

	for (int i = 0; i < p->floorSprite.mulVector.y; i++)
	{
		for (int j = 0; j < p->floorSprite.mulVector.x; j++)
		{
			spriteRect.p1.x = 0;
			spriteRect.p1.y = 0;
			spriteRect.p2 = p->floorSprite.sprite.size;

			baseRect.p1.x = j * p->floorSprite.sprite.size.x;
			baseRect.p1.y = i * p->floorSprite.sprite.size.y;
			baseRect.p2.x = baseRect.p1.x + p->floorSprite.sprite.size.x;
			baseRect.p2.y = baseRect.p1.y + p->floorSprite.sprite.size.y;

			memset(&baseToSpriteOffset, 0, sizeof(baseToSpriteOffset));

			LCD_DrawRect(baseRect);

			RE_RenderSprite(p->floorSprite.sprite.bitmap, baseRect, spriteRect, baseToSpriteOffset, false);
		}
	}

	return 0;
}
