/*
 * Map.c
 *
 *  Created on: 10 cze 2026
 *      Author: tomasz
 */


/*
 * Background.c
 *
 *  Created on: 5 cze 2026
 *      Author: tomasz
 */

#include <stdlib.h>

#include "NES_Functions.h"

#include "LCDControl.h"
#include "RenderEngine.h"
#include "PADControl.h"
#include "Map.h"
#include "NESEngine.h"


const uint16_t map_floor_16x16_dma[256] = {
		0xc3e8, 0x0000, 0x0000, 0x0000, 0x0000, 0x0000, 0x0000, 0xc3e8, 0xbdf7, 0x0000, 0x0000, 0x0000, 0x0000, 0x0000, 0x0000, 0xc3e8,
		0xbdf7, 0x00d0, 0x00d0, 0x00d0, 0x00d0, 0x00d0, 0x00d0, 0x0000, 0xbdf7, 0x00d0, 0x00d0, 0x00d0, 0x00d0, 0x00d0, 0x0000, 0x0000,
		0xbdf7, 0x00d0, 0x00d0, 0x00d0, 0xbdf7, 0xbdf7, 0xbdf7, 0x0000, 0xbdf7, 0x00d0, 0x00d0, 0x00d0, 0x00d0, 0x00d0, 0x00d0, 0x0000,
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		0xc3e8, 0xbdf7, 0xbdf7, 0xbdf7, 0xbdf7, 0xbdf7, 0xbdf7, 0xbdf7, 0xbdf7, 0x0000, 0xc3e8, 0xbdf7, 0xbdf7, 0xbdf7, 0xbdf7, 0xc3e8
};

const uint16_t map_jedynka_32x32_dma[32*32] = {
		0xffff, 0xffff, 0xffff, 0xffff, 0xffff, 0xffff, 0xffff, 0xffff, 0xffff, 0xffff, 0xffff, 0xffff, 0xffff, 0xffff, 0xffff, 0xffff, 0xffff, 0xffff, 0xffff, 0xffff, 0xffff, 0xffff, 0xffff, 0xffff, 0xffff, 0xffff, 0xffff, 0xffff, 0xffff, 0xffff, 0xffff, 0xffff,
		0xffff, 0xffff, 0xffff, 0xffff, 0xffff, 0xffff, 0xffff, 0xffff, 0xffff, 0xffff, 0xffff, 0xffff, 0xffff, 0xffff, 0xffff, 0xffff, 0xffff, 0xffff, 0xffff, 0xffff, 0xffff, 0xffff, 0xffff, 0xffff, 0xffff, 0xffff, 0xffff, 0xffff, 0xffff, 0xffff, 0xffff, 0xffff,
		0xffff, 0xffff, 0xffff, 0xffff, 0xffff, 0xffff, 0xffff, 0xc318, 0xc318, 0xc318, 0xc318, 0xc318, 0xc318, 0xc318, 0xc318, 0xc318, 0xc318, 0xc318, 0xc318, 0xc318, 0xc318, 0xc318, 0xc318, 0xc318, 0xffff, 0xffff, 0xffff, 0xffff, 0xffff, 0xffff, 0xffff, 0xffff,
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		0xffff, 0xffff, 0xffff, 0xffff, 0xffff, 0xffff, 0xffff, 0xffff, 0xffff, 0xffff, 0xffff, 0xffff, 0xffff, 0xffff, 0xc318, 0xc318, 0xc318, 0xffff, 0xffff, 0xffff, 0xffff, 0xffff, 0xffff, 0xffff, 0xffff, 0xffff, 0xffff, 0xffff, 0xffff, 0xffff, 0xffff, 0xffff
};

const uint16_t map_dwojka_32x32_dma[32*32] = {
		0xffff, 0xffff, 0xffff, 0xffff, 0xffff, 0xffff, 0xffff, 0xffff, 0xffff, 0xffff, 0xffff, 0xffff, 0xffff, 0xffff, 0xffff, 0xffff, 0xffff, 0xffff, 0xffff, 0xffff, 0xffff, 0xffff, 0xffff, 0xffff, 0xffff, 0xffff, 0xffff, 0xffff, 0xffff, 0xffff, 0xffff, 0xffff,
		0xffff, 0xffff, 0xffff, 0xffff, 0xffff, 0xffff, 0xffff, 0xffff, 0xffff, 0xffff, 0xffff, 0xffff, 0xffff, 0xffff, 0xffff, 0xffff, 0xffff, 0xffff, 0xffff, 0xffff, 0xffff, 0xffff, 0xffff, 0xffff, 0xffff, 0xffff, 0xffff, 0xffff, 0xffff, 0xffff, 0xffff, 0xffff,
		0xffff, 0xffff, 0xffff, 0xffff, 0xffff, 0xffff, 0xffff, 0xffff, 0xffff, 0xffff, 0xffff, 0xffff, 0xffff, 0xffff, 0xffff, 0xffff, 0xffff, 0xffff, 0xffff, 0xffff, 0xffff, 0xffff, 0xffff, 0xffff, 0xffff, 0xffff, 0xffff, 0xffff, 0xffff, 0xffff, 0xffff, 0xffff,
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		0xffff, 0xffff, 0xffff, 0xffff, 0xffff, 0xffff, 0xffff, 0xffff, 0xffff, 0xffff, 0x4108, 0x4108, 0x4108, 0x4108, 0x4108, 0x4108, 0x4108, 0x4108, 0xffff, 0xffff, 0xffff, 0xffff, 0xffff, 0xffff, 0xffff, 0xffff, 0xffff, 0xffff, 0xffff, 0xffff, 0xffff, 0xffff
};

const uint16_t map_chmurka_32x32_dma[32*32] = {
		0xffff, 0xffff, 0xffff, 0xffff, 0xffff, 0xffff, 0xffff, 0xffff, 0xffff, 0xffff, 0xffff, 0xffff, 0xffff, 0xffff, 0xffff, 0xffff, 0xffff, 0xffff, 0xffff, 0xffff, 0xffff, 0xffff, 0xffff, 0xffff, 0xffff, 0xffff, 0xffff, 0xffff, 0xffff, 0xffff, 0xffff, 0xffff,
		0xffff, 0xffff, 0xffff, 0xffff, 0xffff, 0xffff, 0xffff, 0xffff, 0xffff, 0xffff, 0xffff, 0xffff, 0xffff, 0xffff, 0xffff, 0xffff, 0xffff, 0xffff, 0xffff, 0xffff, 0xffff, 0xffff, 0xffff, 0xffff, 0xffff, 0xffff, 0xffff, 0xffff, 0xffff, 0xffff, 0xffff, 0xffff,
		0xffff, 0xffff, 0xffff, 0xffff, 0xffff, 0xffff, 0xffff, 0xffff, 0xffff, 0xffff, 0xffff, 0xffff, 0xffff, 0xffff, 0xffff, 0xffff, 0xffff, 0xffff, 0xffff, 0xffff, 0xffff, 0xffff, 0xffff, 0xffff, 0xffff, 0xffff, 0xffff, 0xffff, 0xffff, 0xffff, 0xffff, 0xffff,
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		0xffff, 0xffff, 0xffff, 0xffff, 0xffff, 0xffff, 0xffff, 0xffff, 0xffff, 0xffff, 0xffff, 0xffff, 0xffff, 0xffff, 0xffff, 0xffff, 0xffff, 0xffff, 0xffff, 0xffff, 0xffff, 0xffff, 0xffff, 0xffff, 0xffff, 0xffff, 0xffff, 0xffff, 0xffff, 0xffff, 0xffff, 0xffff
};


int Map_Init(Map_t* p)
{
	if (p == NULL)	{ return -1; }

	memset(p, 0, sizeof(Map_t));

	p->LCDOffsetX = 0;

	p->mapSize.p1.x = 0;
	p->mapSize.p1.y = 0;
	p->mapSize.p2.x = MAP_MAX_X;
	p->mapSize.p2.y = MAP_MAX_Y;

	p->currCameraPos.x = 0;
	p->currCameraPos.y = 0;
	p->prevCameraPos.x = 0;
	p->prevCameraPos.y = 0;


	p->floorSprite.sprite.bitmap = map_floor_16x16_dma;
	p->floorSprite.sprite.size.x = 16;
	p->floorSprite.sprite.size.y = 16;
	p->floorSprite.mulVector.x = LCD_WIDTH/16;
	p->floorSprite.mulVector.y = 2;

	p->floorPixelPos.x = 0;
	p->floorPixelPos.y = 0;

	p->floorYLevel = p->floorSprite.sprite.size.y * p->floorSprite.mulVector.y;


	p->jedynkaSprite.bitmap = map_jedynka_32x32_dma;
	p->jedynkaSprite.size.x = JEDYNKA_SIZE_X;
	p->jedynkaSprite.size.y = JEDYNKA_SIZE_Y;


	p->dwojkaSprite.bitmap = map_dwojka_32x32_dma;
	p->dwojkaSprite.size.x = DWOJKA_SIZE_X;
	p->dwojkaSprite.size.y = DWOJKA_SIZE_Y;


	p->chmurkaSprite.bitmap = map_chmurka_32x32_dma;
	p->chmurkaSprite.size.x = CHMURKA_SIZE_X;
	p->chmurkaSprite.size.y = CHMURKA_SIZE_Y;


	memset(&p->dirtyRects, 0, sizeof(p->dirtyRects));

	return 0;
}

Point_t	Map_GetCameraPos(Map_t* p)
{
	Point_t cameraPos = {};
	if (p == NULL)	{ return cameraPos; }
	cameraPos = p->currCameraPos;
	return cameraPos;
}

int Map_ReactToButtons(Map_t* p, uint32_t buttons_state)
{
	if (p == NULL)	{ return -1; }

	Point_t moveVector = {0};
//	Point_t setVector = {0};
	bool useMove = true;

//	if (buttons_state & PAD_BUTTON_START)
//	{
//		setVector.x = 0;
//		setVector.y = 0;
//		useMove = false;
//	}

	if (useMove)
	{
		if (buttons_state & PAD_BUTTON_RIGHT)
		{
			moveVector.x++;
		}
		if (buttons_state & PAD_BUTTON_LEFT)
		{
//			moveVector.x--;
		}
		if (buttons_state & PAD_BUTTON_UP)
		{
//			moveVector.y++;
		}
		if (buttons_state & PAD_BUTTON_DOWN)
		{
//			moveVector.y--;
		}
		if (buttons_state & PAD_BUTTON_A)
		{
//			moveVector.y += 5;
		}
		if (buttons_state & PAD_BUTTON_B)
		{
//			moveVector.y -= 5;
		}

		p->prevCameraPos = p->currCameraPos;
		Point_Move(&p->currCameraPos, &moveVector);
	}
//	else
//	{
//		p->prevCameraPos = p->currCameraPos;
//		p->currCameraPos.x = 0;
//		p->currCameraPos.y = 0;
//	}

	return 0;
}

// RENDER PIPELINE
// Narysuj nowe linie po prawej i po lewej
// 	- Najlepiej po jednym wyslaniu na linie
//	- NOWY TYP RENDEROWANIA (PODLOGI NIE RUSZASZ, ROBISZ TLO + LINIE Z NIERUCHOMYCH SPRITOW)
// Narysuj przeciwnikow
//	- tlo
//	- nieruchome sprity
//	- przeciwnik
//	- NOWY TYP RENDEROWANIA (MUSISZ W DIRTYBOXA PRZECIWNIKA WPISAC FRAGMENTY NIERUCHOMYCH SPRITOW)
// Narysuj mario
//	- tlo
//	- nieruchome sprity
//	- mario
//	- NOWY TYP RENDEROWANIA (MUSISZ W DIRTYBOXA PRZECIWNIKA WPISAC FRAGMENTY NIERUCHOMYCH SPRITOW)

int Map_FirstRender(Map_t* p)
{
	if (p == NULL)	{ return -1; }

	LCD_WriteVertScrollStartAddr(p->LCDOffsetX);

	Map_RenderFloor(p);

	for (int i = 0; i < LCD_WIDTH/20; i++)
	{
		Rect_t mapRect;
		mapRect.p1.x = i * 20;
		mapRect.p1.y = p->floorYLevel;
		mapRect.p2.x = i * 20 + 20;
		mapRect.p2.y = LCD_HEIGHT;

		Rect_t screenRect = mapRect;

		int baseRectArea = CalcRectArea(screenRect);
		int ret = RE_FillBackgroud(LCD_COLOR_BLUESKY, baseRectArea);

		int elementSize = sizeof(SpritePos_t);
		if (elementSize > 0)
		{
			int numOfSprites = sizeof(MapSpriteLoc)/elementSize;
			for (int j = 0; j < numOfSprites; j++)
			{
				SpritePos_t spritePos = MapSpriteLoc[j];
				switch (spritePos.spriteID)
				{
				case JEDYNKA_SPRITE_ID:
				{
					Map_RenderBgdSprite(&p->jedynkaSprite, spritePos, mapRect, screenRect, p->LCDOffsetX, false, false);
					break;
				}
				case DWOJKA_SPRITE_ID:
				{
					Map_RenderBgdSprite(&p->dwojkaSprite, spritePos, mapRect, screenRect, p->LCDOffsetX, false, false);
					break;
				}
				case CHMURKA_SPRITE_ID:
				{
					Map_RenderBgdSprite(&p->chmurkaSprite, spritePos, mapRect, screenRect, p->LCDOffsetX, false, false);
					break;
				}
				}
			}

		}

		RE_SendRect(screenRect, p->LCDOffsetX);
	}

	return 0;
}

int Map_ScrollRender(Map_t* p)
{
	if (p == NULL)	{ return -1; }

	p->cameraDiff.x = p->currCameraPos.x - p->prevCameraPos.x;

	if (p->cameraDiff.x > 0)
	{
		int prevLCDOffsetX = p->LCDOffsetX;

		p->LCDOffsetX -= p->cameraDiff.x;
		if (p->LCDOffsetX > 319)
		{
			p->LCDOffsetX = p->LCDOffsetX - 320;
		}
		if (p->LCDOffsetX < 0)
		{
			p->LCDOffsetX = 320 + p->LCDOffsetX;
		}

//		Rect_t leftMapRect;
		Rect_t rightMapRect;
		Rect_t leftScreenRect;
		Rect_t rightScreenRect;

//		leftMapRect.p1.x = p->prevCameraPos.x;
//		leftMapRect.p1.y = p->floorYLevel;
//		leftMapRect.p2.x = p->currCameraPos.x;
//		leftMapRect.p2.y = LCD_HEIGHT;

		rightMapRect.p1.x = p->prevCameraPos.x + LCD_WIDTH - 1;
		rightMapRect.p1.y = p->floorYLevel;
		rightMapRect.p2.x = p->currCameraPos.x + LCD_WIDTH - 1;
		rightMapRect.p2.y = LCD_HEIGHT;

		leftScreenRect.p1.x = 0;
		leftScreenRect.p1.y = p->floorYLevel;
		leftScreenRect.p2.x = p->cameraDiff.x;
		leftScreenRect.p2.y = LCD_HEIGHT;

		rightScreenRect.p1.x = LCD_WIDTH - p->cameraDiff.x - 1;
		rightScreenRect.p1.y = p->floorYLevel;
		rightScreenRect.p2.x = LCD_WIDTH - 1;
		rightScreenRect.p2.y = LCD_HEIGHT;

		int baseRectArea, ret;

		// LEFT
		baseRectArea = CalcRectArea(leftScreenRect);
		ret = RE_FillBackgroud(LCD_COLOR_BLUESKY, baseRectArea);
		RE_SendRect(leftScreenRect, prevLCDOffsetX);

		// SHIFT SCROLL
		LCD_WriteVertScrollStartAddr(p->LCDOffsetX);

		// RIGHT
		baseRectArea = CalcRectArea(rightScreenRect);
		ret = RE_FillBackgroud(LCD_COLOR_BLUESKY, baseRectArea);

		int elementSize = sizeof(SpritePos_t);
		if (elementSize > 0)
		{
			int numOfSprites = sizeof(MapSpriteLoc)/elementSize;
			for (int i = 0; i < numOfSprites; i++)
			{
				SpritePos_t spritePos = MapSpriteLoc[i];
				switch (spritePos.spriteID)
				{
				case JEDYNKA_SPRITE_ID:
				{
					Map_RenderBgdSprite(&p->jedynkaSprite, spritePos, rightMapRect, rightScreenRect, p->LCDOffsetX, false, false);
					break;
				}
				case DWOJKA_SPRITE_ID:
				{
					Map_RenderBgdSprite(&p->dwojkaSprite, spritePos, rightMapRect, rightScreenRect, p->LCDOffsetX, false, false);
					break;
				}
				case CHMURKA_SPRITE_ID:
				{
					Map_RenderBgdSprite(&p->chmurkaSprite, spritePos, rightMapRect, rightScreenRect, p->LCDOffsetX, false, false);
					break;
				}
				}
			}
		}


		RE_SendRect(rightScreenRect, p->LCDOffsetX);
	}


	return 0;
}

int Map_RenderObjects(Map_t* p)
{
	if (p == NULL)	{ return -1; }
	int ret = 0;
	int dirtyRectIndex = 0;

	uint32_t startTime = 0, elapsedUS = 0;
	startTime = GetTimestamp();
//	memset(&p->dirtyRects, 0, sizeof(p->dirtyRects));
	fast_memset(&p->dirtyRects, 0, sizeof(p->dirtyRects));
	elapsedUS = CalcTimeUS(startTime);
//	if (elapsedUS > 0)
	{
		printf_uint(elapsedUS); printf_c('\t');
	}


	Rect_t cameraRect;
	cameraRect.p1.x = p->currCameraPos.x;
	cameraRect.p1.y = p->currCameraPos.y;
	cameraRect.p2.x = cameraRect.p1.x + LCD_WIDTH;
	cameraRect.p2.y = cameraRect.p1.y + LCD_HEIGHT;

	for (int i = 0; i < NUM_OF_GOOMBAS; i++)
	{
		Goomba_t* goomba = NULL;
		int ret = Enemies_GetGoomba(pEnemies, i, &goomba);
		if (ret < 0)	{ continue; }

		Rect_t dirtyRect;
		if (Goomba_GetDirtyRect(goomba, &dirtyRect) < 0)	{ continue; }

		Rect_t commonRect;
		commonRect.p1.x = max(cameraRect.p1.x, dirtyRect.p1.x);
		commonRect.p1.y = max(cameraRect.p1.y, dirtyRect.p1.y);
		commonRect.p2.x = min(cameraRect.p2.x, dirtyRect.p2.x);
		commonRect.p2.y = min(cameraRect.p2.y, dirtyRect.p2.y);

		// czesc wspolna istnieje
		if (commonRect.p1.x <= commonRect.p2.x && commonRect.p1.y <= commonRect.p2.y)
		{
			p->dirtyRects[dirtyRectIndex].rect = commonRect;
			p->dirtyRects[dirtyRectIndex].objID[p->dirtyRects[dirtyRectIndex].objIDIndex++] = (ObjectID_t){ .objID = GOOMBA_OBJ_ID, .objIndex = i};
			dirtyRectIndex++;
		}
	}

	Rect_t marioDirtyMapRect;
	ret = Map_GetMarioDirtyRect(cameraRect, &marioDirtyMapRect);
	if (!ret)
	{
		p->dirtyRects[dirtyRectIndex].rect = marioDirtyMapRect;
		p->dirtyRects[dirtyRectIndex].objID[p->dirtyRects[dirtyRectIndex].objIDIndex++] = (ObjectID_t){ .objID = MARIO_OBJ_ID, .objIndex = 0};
		dirtyRectIndex++;
	}

	for (int i = 0; i < dirtyRectIndex; i++)
	{
		if (p->dirtyRects[i].used)	{ continue; }

		bool commonRectFound = false;
		for (int j = 0; j < dirtyRectIndex; j++)
		{
			if (i == j)	{ continue; }
			if (p->dirtyRects[j].used)	{ continue; }

			Rect_t commonRect;
			commonRect.p1.x = max(p->dirtyRects[i].rect.p1.x, p->dirtyRects[j].rect.p1.x);
			commonRect.p1.y = max(p->dirtyRects[i].rect.p1.y, p->dirtyRects[j].rect.p1.y);
			commonRect.p2.x = min(p->dirtyRects[i].rect.p2.x, p->dirtyRects[j].rect.p2.x);
			commonRect.p2.y = min(p->dirtyRects[i].rect.p2.y, p->dirtyRects[j].rect.p2.y);

			// czesc wspolna istnieje
			if (commonRect.p1.x <= commonRect.p2.x && commonRect.p1.y <= commonRect.p2.y)
			{
				Rect_t commonORRect;
				commonORRect.p1.x = min(p->dirtyRects[i].rect.p1.x, p->dirtyRects[j].rect.p1.x);
				commonORRect.p1.y = min(p->dirtyRects[i].rect.p1.y, p->dirtyRects[j].rect.p1.y);
				commonORRect.p2.x = max(p->dirtyRects[i].rect.p2.x, p->dirtyRects[j].rect.p2.x);
				commonORRect.p2.y = max(p->dirtyRects[i].rect.p2.y, p->dirtyRects[j].rect.p2.y);

				commonRectFound = true;
				p->dirtyRects[j].used = true;
				p->dirtyRects[i].rect = commonORRect;
				for (int k = 0; k < p->dirtyRects[j].objIDIndex; k++)
				{
					p->dirtyRects[i].objID[p->dirtyRects[i].objIDIndex++] = p->dirtyRects[j].objID[k];
				}
				break;
			}
		}

		if (commonRectFound)
		{
			i--;
		}
	}

	for (int i = 0; i < dirtyRectIndex; i++)
	{
		if (p->dirtyRects[i].used)	{ continue; }

		DirtyRect_t* dirtyRect = &p->dirtyRects[i];

		Rect_t screenRect;
		screenRect.p1.x = dirtyRect->rect.p1.x - p->currCameraPos.x;
		screenRect.p1.y = dirtyRect->rect.p1.y - p->currCameraPos.y;
		screenRect.p2.x = dirtyRect->rect.p2.x - p->currCameraPos.x;
		screenRect.p2.y = dirtyRect->rect.p2.y - p->currCameraPos.y;

		// BACKGROUND COLOR
		int baseRectArea = CalcRectArea(dirtyRect->rect);
		RE_FillBackgroud(LCD_COLOR_BLUESKY, baseRectArea);

		// BACKGROUND SPRITES
		int elementSize = sizeof(SpritePos_t);
		if (elementSize > 0)
		{
			int numOfSprites = sizeof(MapSpriteLoc)/elementSize;
			for (int i = 0; i < numOfSprites; i++)
			{
				SpritePos_t spritePos = MapSpriteLoc[i];
				switch (spritePos.spriteID)
				{
				case JEDYNKA_SPRITE_ID:
				{
					Map_RenderBgdSprite(&p->jedynkaSprite, spritePos, dirtyRect->rect, screenRect, p->LCDOffsetX, false, false);
					break;
				}
				case DWOJKA_SPRITE_ID:
				{
					Map_RenderBgdSprite(&p->dwojkaSprite, spritePos, dirtyRect->rect, screenRect, p->LCDOffsetX, false, false);
					break;
				}
				case CHMURKA_SPRITE_ID:
				{
					Map_RenderBgdSprite(&p->chmurkaSprite, spritePos, dirtyRect->rect, screenRect, p->LCDOffsetX, false, false);
					break;
				}
				}
			}
		}

		for (int j = 0; j < NUM_OF_OBJ_IDS; j++)
		{
			int currentPrioObject = ObjPriorities[j];

			for (int k = 0; k < dirtyRect->objIDIndex; k++)
			{
				int objID = dirtyRect->objID[k].objID;
				if (objID != currentPrioObject)
				{
					continue;
				}

				switch (objID)
				{
				case MARIO_OBJ_ID:
				{
					Map_RenderMario(p->currCameraPos, dirtyRect->rect, screenRect, p->LCDOffsetX);
					break;
				}
				case GOOMBA_OBJ_ID:
				{
					Goomba_t* goomba = NULL;
					int ret = Enemies_GetGoomba(pEnemies, dirtyRect->objID[k].objIndex, &goomba);
					if (ret < 0)	{ break; }

					Map_RenderGoomba(goomba, p->currCameraPos, dirtyRect->rect, screenRect, p->LCDOffsetX);
					break;
				}
				default:
					break;
				}
			}
		}

		RE_SendRect(screenRect, p->LCDOffsetX);
	}

	return 0;
}

int Map_GetMarioDirtyRect(Rect_t cameraRect, Rect_t* dirtyMapRect)
{
	if (dirtyMapRect == NULL)	{ return -1; }

	Rect_t dirtyRect;
	if (Mario_GetDirtyRect(pMario, &dirtyRect) < 0)	{ return -5; }

	Rect_t commonRect;
	commonRect.p1.x = max(cameraRect.p1.x, dirtyRect.p1.x);
	commonRect.p1.y = max(cameraRect.p1.y, dirtyRect.p1.y);
	commonRect.p2.x = min(cameraRect.p2.x, dirtyRect.p2.x);
	commonRect.p2.y = min(cameraRect.p2.y, dirtyRect.p2.y);

	// czesc wspolna istnieje
	if (commonRect.p1.x <= commonRect.p2.x && commonRect.p1.y <= commonRect.p2.y)
	{
		*dirtyMapRect = commonRect;
		return 0;
	}
	else
	{
		return -10;
	}
}

int Map_RenderMario(Point_t cameraPos, Rect_t dirtyMapRect, Rect_t screenRect, int LCDOffsetX)
{
	Point_t mapPos;
	if (Mario_GetMapPos(pMario, &mapPos) < 0)	{ return -10; }

	Sprite_t* sprite = Mario_GetSprite(pMario);
	if (sprite == NULL)	{ return -15; }

	Rect_t posRect;
	posRect.p1.x = mapPos.x;
	posRect.p1.y = mapPos.y;
	posRect.p2.x = mapPos.x + sprite->size.x;
	posRect.p2.y = mapPos.y + sprite->size.y;

	Rect_t commonRect;
	commonRect.p1.x = max(dirtyMapRect.p1.x, posRect.p1.x);
	commonRect.p1.y = max(dirtyMapRect.p1.y, posRect.p1.y);
	commonRect.p2.x = min(dirtyMapRect.p2.x, posRect.p2.x);
	commonRect.p2.y = min(dirtyMapRect.p2.y, posRect.p2.y);

	// czesc wspolna istnieje
	if (commonRect.p1.x <= commonRect.p2.x && commonRect.p1.y <= commonRect.p2.y)
	{
		SpriteRender_t renderContext;
		renderContext.commonRect = commonRect;
		renderContext.baseRect = screenRect;
		renderContext.baseToSpriteOffset.x = mapPos.x - dirtyMapRect.p1.x;
		renderContext.baseToSpriteOffset.y = mapPos.y - dirtyMapRect.p1.y;
		renderContext.LCDOffsetX = LCDOffsetX;

		RE_FillSprite3(sprite, renderContext);
	}

	return 0;
}

//int Map_GetGoombaDirtyRect(Rect_t cameraRect, Rect_t* dirtyMapRect)
//{
//	if (dirtyMapRect == NULL)	{ return -1; }
//
//	Rect_t dirtyRect;
//	if (Goomba_GetDirtyRect(pGoomba, &dirtyRect) < 0)	{ return -5; }
//
//	Rect_t commonRect;
//	commonRect.p1.x = max(cameraRect.p1.x, dirtyRect.p1.x);
//	commonRect.p1.y = max(cameraRect.p1.y, dirtyRect.p1.y);
//	commonRect.p2.x = min(cameraRect.p2.x, dirtyRect.p2.x);
//	commonRect.p2.y = min(cameraRect.p2.y, dirtyRect.p2.y);
//
//	// czesc wspolna istnieje
//	if (commonRect.p1.x <= commonRect.p2.x && commonRect.p1.y <= commonRect.p2.y)
//	{
//		*dirtyMapRect = commonRect;
//		return 0;
//	}
//	else
//	{
//		return -10;
//	}
//}

int Map_RenderGoomba(Goomba_t* goomba, Point_t cameraPos, Rect_t dirtyMapRect, Rect_t screenRect, int LCDOffsetX)
{
	if (goomba == NULL)	{ return -1; }

	Point_t mapPos;
	if (Goomba_GetMapPos(goomba, &mapPos) < 0)	{ return -10; }

	Sprite_t* sprite = Goomba_GetSprite(goomba);
	if (sprite == NULL)	{ return -15; }

	Rect_t posRect;
	posRect.p1.x = mapPos.x;
	posRect.p1.y = mapPos.y;
	posRect.p2.x = mapPos.x + sprite->size.x;
	posRect.p2.y = mapPos.y + sprite->size.y;

	Rect_t commonRect;
	commonRect.p1.x = max(dirtyMapRect.p1.x, posRect.p1.x);
	commonRect.p1.y = max(dirtyMapRect.p1.y, posRect.p1.y);
	commonRect.p2.x = min(dirtyMapRect.p2.x, posRect.p2.x);
	commonRect.p2.y = min(dirtyMapRect.p2.y, posRect.p2.y);

	// czesc wspolna istnieje
	if (commonRect.p1.x <= commonRect.p2.x && commonRect.p1.y <= commonRect.p2.y)
	{
		SpriteRender_t renderContext;
		renderContext.commonRect = commonRect;
		renderContext.baseRect = screenRect;
		renderContext.baseToSpriteOffset.x = mapPos.x - dirtyMapRect.p1.x;
		renderContext.baseToSpriteOffset.y = mapPos.y - dirtyMapRect.p1.y;
		renderContext.LCDOffsetX = LCDOffsetX;

		RE_FillSprite3(sprite, renderContext);
	}

	return 0;
}

int Map_RenderBgdSprite(Sprite_t* p, SpritePos_t spritePos, Rect_t mapRectToDraw, Rect_t screenRect, int LCDOffsetX, bool render, bool fillBG)
{
	if (p == NULL)	{ return -1; }

	Rect_t posRect;
	posRect.p1.x = spritePos.x;
	posRect.p1.y = spritePos.y;
	posRect.p2.x = spritePos.x + p->size.x;
	posRect.p2.y = spritePos.y + p->size.y;

	Rect_t commonRect;
	commonRect.p1.x = max(mapRectToDraw.p1.x, posRect.p1.x);
	commonRect.p1.y = max(mapRectToDraw.p1.y, posRect.p1.y);
	commonRect.p2.x = min(mapRectToDraw.p2.x, posRect.p2.x);
	commonRect.p2.y = min(mapRectToDraw.p2.y, posRect.p2.y);

	// czesc wspolna istnieje
	if (commonRect.p1.x <= commonRect.p2.x && commonRect.p1.y <= commonRect.p2.y)
	{
		SpriteRender_t renderContext;
		renderContext.commonRect = commonRect;
		renderContext.baseRect = screenRect;
		renderContext.baseToSpriteOffset.x = posRect.p1.x - mapRectToDraw.p1.x;
		renderContext.baseToSpriteOffset.y = posRect.p1.y - mapRectToDraw.p1.y;
		renderContext.LCDOffsetX = LCDOffsetX;

		if (render)
		{
			RE_RenderSprite(p, renderContext, fillBG);
		}
		else
		{
			RE_FillSprite3(p, renderContext);
		}
	}

	return 0;
}

int Map_RenderFloor(Map_t* p)
{
	if (p == NULL)	{ return -1; }
	Sprite_t* s = &p->floorSprite.sprite;

	SpriteRender_t renderContext;

	for (int i = 0; i < p->floorSprite.mulVector.y; i++)
	{
		for (int j = 0; j < p->floorSprite.mulVector.x; j++)
		{
			renderContext.baseRect.p1.x = j * p->floorSprite.sprite.size.x;
			renderContext.baseRect.p1.y = i * p->floorSprite.sprite.size.y;
			renderContext.baseRect.p2.x = renderContext.baseRect.p1.x + p->floorSprite.sprite.size.x;
			renderContext.baseRect.p2.y = renderContext.baseRect.p1.y + p->floorSprite.sprite.size.y;

			renderContext.commonRect = renderContext.baseRect;

			renderContext.baseToSpriteOffset.x = 0;
			renderContext.baseToSpriteOffset.y = 0;
			renderContext.LCDOffsetX = 0;

			RE_RenderSprite(s, renderContext, false);
		}
	}

	return 0;
}
